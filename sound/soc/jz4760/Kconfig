## sound/soc/jz4760/Kconfig
```kconfig
config SND_JZ4760_SOC
	tristate "SoC Audio for Ingenic jz4760 chip"
	depends on (JZ4760_LEPUS || JZ4760B_LEPUS) && SND_SOC
	help
	  Say Y or M if you want to add support for codecs attached to
	  the Jz4760 AC97, I2S or SSP interface. You will also need
	  to select the audio interfaces to support below.

config SND_JZ4760_SOC_LEPUS
	tristate "SoC Audio support for Ingenic Jz4760 LEPUS board"
	depends on SND_JZ4760_SOC
	help
	  Say Y if you want to add support for SoC audio of internal codec on Ingenic Jz4760 LEPUS board.

config SND_JZ4760_AC97
	tristate "select AC97 protocol and AC97 codec pcm core support"
	depends on SND_JZ4760_SOC && SND_JZ4760_SOC_LEPUS
	select SND_AC97_CODEC
	help
	  Say Y if you want to add AC97 protocol support for pcm core.

config SND_JZ4760_SOC_AC97
	tristate "SoC Audio (AC97 protocol) for Ingenic jz4760 chip"
	depends on SND_JZ4760_SOC && SND_JZ4760_AC97 && SND_JZ4760_SOC_LEPUS
	select AC97_BUS
	select SND_SOC_AC97_BUS
	help
	  Say Y if you want to use AC97 protocol and ac97 codec on Ingenic Jz4760 LEPUS board.

config SND_JZ4760_SOC_I2S
	depends on SND_JZ4760_SOC && SND_JZ4760_SOC_LEPUS
	tristate "SoC Audio (I2S protocol) for Ingenic jz4760 chip"
	help
	  Say Y if you want to use I2S protocol and I2S codec on Ingenic Jz4760 LEPUS board.
```

## sound/soc/jz4770/Kconfig
```kconfig
config SND_JZ4770_SOC
	tristate "SoC Audio for Ingenic jz4770 chip"
	depends on SOC_JZ4770 && SND_SOC
	help
	  Say Y or M if you want to add support for codecs attached to
	  the Jz4770 AC97, I2S controller.

config SND_JZ4770_SOC_I2S
        tristate

config SND_JZ4770_SOC_PISCES_ICDC
	tristate "SoC I2S Audio support for JZ4770 Pisces reference board with internal codec"
	depends on SND_JZ4770_SOC
	select SND_JZ4770_SOC_I2S
	select SND_SOC_JZ4770_ICDC
	help
	  Say Y if you want to add audio support for JZ4770 Pisces reference board with internal codec.
```
